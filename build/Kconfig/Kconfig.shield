## build/Kconfig/Kconfig.shield
```kconfig
osource "C:/my_boards/boards/shields/*/Kconfig.shield"
osource "C:/Users/gokul_2rbw/OneDrive/Documents/Driver/hx711_2025/boards/shields/*/Kconfig.shield"
osource "C:/ncs/v2.9.0/nrf/boards/shields/*/Kconfig.shield"
```

## build/Kconfig/Kconfig.shield.defconfig
```kconfig
osource "C:/my_boards/boards/shields/*/Kconfig.defconfig"
osource "C:/Users/gokul_2rbw/OneDrive/Documents/Driver/hx711_2025/boards/shields/*/Kconfig.defconfig"
osource "C:/ncs/v2.9.0/nrf/boards/shields/*/Kconfig.defconfig"
```

## build/hx711_2025/Kconfig/Kconfig.shield.defconfig
```kconfig
osource "C:/my_boards/boards/shields/*/Kconfig.defconfig"
osource "C:/ncs/v2.9.0/nrf/boards/shields/*/Kconfig.defconfig"
```
