## CMakeLists.txt
```
# SPDX-License-Identifier: Apache-2.0

cmake_minimum_required(VERSION 3.21.0)

find_package(Zephyr REQUIRED HINTS $ENV{ZEPHYR_BASE})
project(hx711_2025)

target_sources(app PRIVATE src/main.c src/hx711_driver.c src/hx711_advanced.c src/hx711_demo.c) 
```

## prj.conf
```kconfig
# HX711 Multi-Sensor Configuration
CONFIG_GPIO=y
CONFIG_SENSOR=y

# Logging configuration
CONFIG_LOG=y
CONFIG_LOG_MODE_DEFERRED=y
CONFIG_LOG_DEFAULT_LEVEL=3
CONFIG_LOG_MAX_LEVEL=4

# Console and output
CONFIG_STDOUT_CONSOLE=y
CONFIG_NEWLIB_LIBC=y
CONFIG_NEWLIB_LIBC_FLOAT_PRINTF=y

# Power management
CONFIG_PM_DEVICE=y

# Thread configuration
CONFIG_MAIN_STACK_SIZE=4096
CONFIG_HEAP_MEM_POOL_SIZE=2048

# Math library
CONFIG_FPU=y
CONFIG_FP_HARDABI=y 
```

## boards/nrf52840dk_nrf52840.overlay
```dts
/* Disable UART0 to free up GPIO pins */
&uart0 {
        status = "disabled";
    };

    /* Ensure GPIO is enabled */
&gpio0 {
        status = "okay";
    };

&gpio1 {
        status = "okay";
    };
```

## src/main.c
```c
/*
 * Copyright (c) 2025 HX711 Multi-Sensor Application by GP
 * SPDX-License-Identifier: Apache-2.0
 */

#include <zephyr/kernel.h>
#include <zephyr/device.h>
#include <zephyr/drivers/gpio.h>
#include <zephyr/sys/printk.h>
#include <zephyr/logging/log.h>
#include <math.h>
#include "hx711_driver.h"
#include "hx711_config.h"
#include "hx711_advanced.h"
#include "hx711_demo.h"
#include <stdint.h>
#include <zephyr/devicetree.h>

LOG_MODULE_REGISTER(main, CONFIG_LOG_DEFAULT_LEVEL);

/* HX711 sensor instances */
static struct hx711_data hx711_0_data;
static struct hx711_data hx711_1_data;
static struct hx711_data hx711_2_data;

/* Advanced HX711 sensor instances */
static struct hx711_advanced_data hx711_adv_0_data;
static struct hx711_advanced_data hx711_adv_1_data;
static struct hx711_advanced_data hx711_adv_2_data;

/* Function prototypes */
void test_hardware_connections(void);
void test_individual_sensors(void);
void run_comprehensive_calibration(void);
void print_weight_measurements(void);
void print_sensor_calibration_status(struct hx711_advanced_data *hx711, const char *name);

/* Hardware test function */
void test_hardware_connections(void)
{
	LOG_INF("=== HARDWARE CONNECTION TEST ===");
	
	/* Test GPIO devices */
	const struct device *gpio0 = DEVICE_DT_GET(DT_NODELABEL(gpio0));
	const struct device *gpio1 = DEVICE_DT_GET(DT_NODELABEL(gpio1));
	
	if (!device_is_ready(gpio0)) {
		LOG_ERR("GPIO0 device not ready!");
		return;
	}
	LOG_INF("GPIO0 device is ready");
	
	if (!device_is_ready(gpio1)) {
		LOG_ERR("GPIO1 device not ready!");
		return;
	}
	LOG_INF("GPIO1 device is ready");
	
	/* Test SCK pins as outputs */
	LOG_INF("Testing SCK pins as outputs...");
	
	/* Configure and test SCK pins */
	gpio_pin_configure(gpio1, HX711_0_SCK_PIN, GPIO_OUTPUT | GPIO_OUTPUT_LOW);
	gpio_pin_configure(gpio1, HX711_1_SCK_PIN, GPIO_OUTPUT | GPIO_OUTPUT_LOW);
	gpio_pin_configure(gpio1, HX711_2_SCK_PIN, GPIO_OUTPUT | GPIO_OUTPUT_LOW);
	
	/* Test SCK pins high */
	gpio_pin_set(gpio1, HX711_0_SCK_PIN, 1);
	gpio_pin_set(gpio1, HX711_1_SCK_PIN, 1);
	gpio_pin_set(gpio1, HX711_2_SCK_PIN, 1);
	k_msleep(100);
	
	/* Test SCK pins low */
	gpio_pin_set(gpio1, HX711_0_SCK_PIN, 0);
	gpio_pin_set(gpio1, HX711_1_SCK_PIN, 0);
	gpio_pin_set(gpio1, HX711_2_SCK_PIN, 0);
	k_msleep(100);
	
	LOG_INF("SCK pins configured successfully");
	
	/* Test DOUT pins as inputs */
	LOG_INF("Testing DOUT pins as inputs...");
	
	gpio_pin_configure(gpio0, HX711_0_DOUT_PIN, GPIO_INPUT | GPIO_PULL_UP);
	gpio_pin_configure(gpio0, HX711_1_DOUT_PIN, GPIO_INPUT | GPIO_PULL_UP);
	gpio_pin_configure(gpio0, HX711_2_DOUT_PIN, GPIO_INPUT | GPIO_PULL_UP);
	
	/* Read DOUT pin states */
	int dout0 = gpio_pin_get(gpio0, HX711_0_DOUT_PIN);
	int dout1 = gpio_pin_get(gpio0, HX711_1_DOUT_PIN);
	int dout2 = gpio_pin_get(gpio0, HX711_2_DOUT_PIN);
	
	LOG_INF("DOUT pin states: %d %d %d", dout0, dout1, dout2);
	
	if (dout0 == 1 && dout1 == 1 && dout2 == 1) {
		LOG_WRN("All DOUT pins are HIGH - sensors may not be connected!");
		LOG_INF("Check your wiring:");
		LOG_INF("- VCC to 3.3V or 5V");
		LOG_INF("- GND to GND");
		LOG_INF("- DOUT to GPIO0 pins (with pull-up)");
		LOG_INF("- SCK to GPIO1 pins");
	} else {
		LOG_INF("Some sensors appear to be connected");
	}
	
	LOG_INF("=== END HARDWARE TEST ===");
}

/* Individual sensor test function */
void test_individual_sensors(void)
{
	LOG_INF("=== INDIVIDUAL SENSOR TEST ===");
	
	const struct device *gpio0 = DEVICE_DT_GET(DT_NODELABEL(gpio0));
	const struct device *gpio1 = DEVICE_DT_GET(DT_NODELABEL(gpio1));
	
	/* Test each sensor individually */
	for (int sensor = 0; sensor < 3; sensor++) {
		int sck_pin, dout_pin;
		const char *sensor_name;
		const struct device *sck_dev;
		
		switch(sensor) {
			case 0:
				sck_pin = HX711_0_SCK_PIN;
				dout_pin = HX711_0_DOUT_PIN;
				sensor_name = "Sensor 0";
				sck_dev = gpio1;
				break;
			case 1:
				sck_pin = HX711_1_SCK_PIN;
				dout_pin = HX711_1_DOUT_PIN;
				sensor_name = "Sensor 1";
				sck_dev = gpio1;
				break;
			case 2:
				sck_pin = HX711_2_SCK_PIN;
				dout_pin = HX711_2_DOUT_PIN;
				sensor_name = "Sensor 2";
				sck_dev = gpio1;
				break;
		}
		
		LOG_INF("--- Testing %s (SCK: GPIO1.%d, DOUT: GPIO0.%d) ---", 
		       sensor_name, sck_pin, dout_pin);
		
		/* Configure pins */
		gpio_pin_configure(sck_dev, sck_pin, GPIO_OUTPUT | GPIO_OUTPUT_LOW);
		gpio_pin_configure(gpio0, dout_pin, GPIO_INPUT | GPIO_PULL_UP);
		
		/* Read initial DOUT state */
		int initial_dout = gpio_pin_get(gpio0, dout_pin);
		LOG_INF("Initial DOUT state: %d", initial_dout);
		
		/* Test SCK control */
		gpio_pin_set(sck_dev, sck_pin, 1);
		k_msleep(50);
		gpio_pin_set(sck_dev, sck_pin, 0);
		k_msleep(50);
		
		/* Read DOUT after SCK pulse */
		int after_dout = gpio_pin_get(gpio0, dout_pin);
		LOG_INF("DOUT after SCK pulse: %d", after_dout);
		
		if (initial_dout == 1 && after_dout == 1) {
			LOG_WRN("RESULT: %s appears to be disconnected or not powered", sensor_name);
			LOG_INF("TROUBLESHOOTING:");
			LOG_INF("1. Check VCC connection (3.3V or 5V)");
			LOG_INF("2. Check GND connection");
			LOG_INF("3. Check load cell wiring to HX711");
			LOG_INF("4. Check DOUT and SCK wire connections");
			LOG_INF("5. Try a different load cell");
		} else if (initial_dout == 0 || after_dout == 0) {
			LOG_INF("RESULT: %s appears to be connected and responding", sensor_name);
		}
	}
	
	LOG_INF("=== END INDIVIDUAL SENSOR TEST ===");
}

/* Comprehensive calibration function */
void run_comprehensive_calibration(void) {
	LOG_INF("=== HX711 COMPREHENSIVE CALIBRATION ===");
	
	struct hx711_advanced_data *sensors[] = {&hx711_adv_0_data, &hx711_adv_1_data, &hx711_adv_2_data};
	const char *sensor_names[] = {"Sensor 0", "Sensor 1", "Sensor 2"};
	
	for (int sensor_id = 0; sensor_id < 3; sensor_id++) {
		LOG_INF("--- Calibrating %s ---", sensor_names[sensor_id]);
		
		/* Step 1: Initial State */
		LOG_INF("Step 1: Initial State");
		float initial_raw = hx711_read_average(sensors[sensor_id], 3);
		LOG_INF("  Raw reading: %.2f", initial_raw);
		LOG_INF("  Current scale: %.6f", hx711_get_scale(sensors[sensor_id]));
		LOG_INF("  Current tare: %.2f", hx711_get_tare(sensors[sensor_id]));
		
		/* Step 2: Tare (Zero Calibration) */
		LOG_INF("Step 2: Tare Calibration (Remove all weight from %s)", sensor_names[sensor_id]);
		LOG_INF("  Press any key when %s is empty, then wait 3 seconds...", sensor_names[sensor_id]);
		k_sleep(K_SECONDS(3));
		
		hx711_tare(sensors[sensor_id], 10); // Take 10 readings for stable tare
		LOG_INF("  Tare offset set to: %.2f", hx711_get_tare(sensors[sensor_id]));
		
		/* Step 3: Scale Calibration */
		LOG_INF("Step 3: Scale Calibration");
		LOG_INF("  Place a known weight (e.g., 1000g) on %s", sensor_names[sensor_id]);
		LOG_INF("  Press any key when weight is placed, then wait 3 seconds...");
		k_sleep(K_SECONDS(3));
		
		/* Read the raw value with known weight */
		float raw_with_weight = hx711_read_average(sensors[sensor_id], 5);
		
		/* Calculate scale factor (assuming 1000g known weight) */
		float known_weight_g = 1000.0f; // Known weight in grams
		float tare_offset = hx711_get_tare(sensors[sensor_id]);
		float scale_factor = (raw_with_weight - tare_offset) / known_weight_g;
		
		hx711_set_scale(sensors[sensor_id], scale_factor);
		LOG_INF("  Raw reading with weight: %.2f", raw_with_weight);
		LOG_INF("  Scale factor calculated: %.6f", scale_factor);
		LOG_INF("  This means 1 unit = %.4f grams", 1.0f / scale_factor);
		
		/* Step 4: Verify Calibration */
		LOG_INF("Step 4: Verify Calibration");
		float measured_weight = hx711_get_units(sensors[sensor_id], 5);
		float error_percent = ((measured_weight - known_weight_g) / known_weight_g) * 100.0f;
		
		LOG_INF("  Measured weight: %.1f grams", measured_weight);
		LOG_INF("  Expected weight: %.1f grams", known_weight_g);
		LOG_INF("  Error: %.2f%%", error_percent);
		
		if (fabs(error_percent) < 5.0f) {
			LOG_INF("  ✓ Calibration successful! Error < 5%%");
		} else {
			LOG_WRN("  ⚠ Calibration may need adjustment. Error > 5%%");
		}
		
		/* Step 5: Test Different Weights */
		LOG_INF("Step 5: Test Different Weights");
		LOG_INF("  Remove weight from %s and wait 2 seconds...", sensor_names[sensor_id]);
		k_sleep(K_SECONDS(2));
		
		float zero_weight = hx711_get_units(sensors[sensor_id], 3);
		LOG_INF("  Zero reading: %.1f grams", zero_weight);
		
		LOG_INF("  Place half weight (500g) on %s and wait 2 seconds...", sensor_names[sensor_id]);
		k_sleep(K_SECONDS(2));
		
		float half_weight = hx711_get_units(sensors[sensor_id], 3);
		LOG_INF("  Half weight reading: %.1f grams", half_weight);
		
		LOG_INF("--- End %s Calibration ---", sensor_names[sensor_id]);
		k_sleep(K_SECONDS(2));
	}
	
	LOG_INF("=== All Sensors Calibrated ===");
}

/* Print weight measurements in multiple units */
void print_weight_measurements(void) {
	LOG_INF("=== WEIGHT MEASUREMENTS ===");
	
	struct hx711_advanced_data *sensors[] = {&hx711_adv_0_data, &hx711_adv_1_data, &hx711_adv_2_data};
	const char *sensor_names[] = {"Sensor 0", "Sensor 1", "Sensor 2"};
	
	for (int i = 0; i < 3; i++) {
		float weight_g = hx711_get_units(sensors[i], 3);
		float weight_kg = weight_g / 1000.0f;
		float weight_lbs = weight_g * 0.00220462f;
		float force_n = weight_g * 0.00980665f;
		
		LOG_INF("%s:", sensor_names[i]);
		LOG_INF("  Weight: %.1f grams", weight_g);
		LOG_INF("  Weight: %.3f kg", weight_kg);
		LOG_INF("  Weight: %.2f lbs", weight_lbs);
		LOG_INF("  Force:  %.3f N", force_n);
	}
}

/* Print sensor calibration status */
void print_sensor_calibration_status(struct hx711_advanced_data *hx711, const char *name) {
	if (!hx711 || !name) {
		return;
	}
	
	LOG_INF("%s Calibration Status:", name);
	LOG_INF("  Scale Factor:  %.6f", hx711_get_scale(hx711));
	LOG_INF("  Tare Offset:   %.2f", hx711_get_tare(hx711));
	LOG_INF("  Calibration:   %s", hx711_get_scale(hx711) > 1.0f ? "Calibrated" : "Not Calibrated");
	LOG_INF("  Gain Setting:  %d", hx711_get_gain(hx711));
	LOG_INF("  Reading Mode:  %d", hx711_get_mode(hx711));
}

int main(void)
{
	int ret;
	uint32_t sample_count = 0;

	LOG_INF("=== HX711 Multi-Sensor Application Starting ===");
	LOG_INF("Supporting 3 HX711 sensors with comprehensive calibration");

	/* Run hardware connection test */
	test_hardware_connections();
	k_sleep(K_SECONDS(1));
	
	/* Run individual sensor test */
	test_individual_sensors();
	k_sleep(K_SECONDS(2));

	/* Initialize HX711 sensors using device tree GPIO definitions */
	ret = hx711_init(&hx711_0_data, 
	                 HX711_0_DOUT_DEV, HX711_0_DOUT_PIN, HX711_0_DOUT_FLAGS,
	                 HX711_0_SCK_DEV, HX711_0_SCK_PIN, HX711_0_SCK_FLAGS);
	if (ret < 0) {
		LOG_ERR("Failed to initialize HX711 sensor 0: %d", ret);
		return -1;
	}

	ret = hx711_init(&hx711_1_data, 
	                 HX711_1_DOUT_DEV, HX711_1_DOUT_PIN, HX711_1_DOUT_FLAGS,
	                 HX711_1_SCK_DEV, HX711_1_SCK_PIN, HX711_1_SCK_FLAGS);
	if (ret < 0) {
		LOG_ERR("Failed to initialize HX711 sensor 1: %d", ret);
		return -1;
	}

	ret = hx711_init(&hx711_2_data, 
	                 HX711_2_DOUT_DEV, HX711_2_DOUT_PIN, HX711_2_DOUT_FLAGS,
	                 HX711_2_SCK_DEV, HX711_2_SCK_PIN, HX711_2_SCK_FLAGS);
	if (ret < 0) {
		LOG_ERR("Failed to initialize HX711 sensor 2: %d", ret);
		return -1;
	}

	/* Set all sensors to 80 SPS */
	hx711_set_rate(&hx711_0_data, 80);
	hx711_set_rate(&hx711_1_data, 80);
	hx711_set_rate(&hx711_2_data, 80);

	LOG_INF("All basic HX711 sensors initialized successfully");
	
	/* Initialize advanced HX711 sensors */
	ret = hx711_advanced_init(&hx711_adv_0_data, 
	                         HX711_0_DOUT_DEV, HX711_0_DOUT_PIN, HX711_0_DOUT_FLAGS,
	                         HX711_0_SCK_DEV, HX711_0_SCK_PIN, HX711_0_SCK_FLAGS);
	if (ret < 0) {
		LOG_ERR("Failed to initialize advanced HX711 sensor 0: %d", ret);
	} else {
		LOG_INF("Advanced HX711 sensor 0 initialized successfully");
	}

	ret = hx711_advanced_init(&hx711_adv_1_data, 
	                         HX711_1_DOUT_DEV, HX711_1_DOUT_PIN, HX711_1_DOUT_FLAGS,
	                         HX711_1_SCK_DEV, HX711_1_SCK_PIN, HX711_1_SCK_FLAGS);
	if (ret < 0) {
		LOG_ERR("Failed to initialize advanced HX711 sensor 1: %d", ret);
	} else {
		LOG_INF("Advanced HX711 sensor 1 initialized successfully");
	}

	ret = hx711_advanced_init(&hx711_adv_2_data, 
	                         HX711_2_DOUT_DEV, HX711_2_DOUT_PIN, HX711_2_DOUT_FLAGS,
	                         HX711_2_SCK_DEV, HX711_2_SCK_PIN, HX711_2_SCK_FLAGS);
	if (ret < 0) {
		LOG_ERR("Failed to initialize advanced HX711 sensor 2: %d", ret);
	} else {
		LOG_INF("Advanced HX711 sensor 2 initialized successfully");
	}
	
	/* Run comprehensive calibration */
	LOG_INF("=== Starting Comprehensive Calibration ===");
	run_comprehensive_calibration();
	k_sleep(K_SECONDS(2));
	
	/* Run the advanced demo */
	LOG_INF("=== Running HX711 Advanced Functions Demo ===");
	run_hx711_advanced_demo();
	k_sleep(K_SECONDS(2));
	
	LOG_INF("=== Starting Continuous Weight Monitoring ===");
	LOG_INF("Press Ctrl+C to stop");

	/* Main loop - continuous weight monitoring */
	while (1) {
		sample_count++;
		LOG_INF("=== Reading #%u ===", sample_count);
		
		/* Print weight measurements for all sensors */
		print_weight_measurements();
		
		/* Print calibration status every 10 readings */
		if (sample_count % 10 == 0) {
			LOG_INF("=== Calibration Status ===");
			print_sensor_calibration_status(&hx711_adv_0_data, "Sensor 0");
			print_sensor_calibration_status(&hx711_adv_1_data, "Sensor 1");
			print_sensor_calibration_status(&hx711_adv_2_data, "Sensor 2");
		}
		
		LOG_INF("--- End Reading #%u ---", sample_count);
		k_sleep(K_SECONDS(5)); // 5 second interval between readings
	}
} 
```

## src/hx711_advanced.c
```c
/*
 * Copyright (c) 2025 HX711 Advanced Functions for Zephyr by GP
 * SPDX-License-Identifier: Apache-2.0
 */

#include "hx711_advanced.h"
#include <zephyr/kernel.h>
#include <zephyr/sys/printk.h>
#include <math.h>
#include <string.h>

/* Helper function for insertion sort (used in median calculations) */
static void insert_sort(float *array, uint8_t size)
{
    for (uint8_t i = 1; i < size; i++) {
        float key = array[i];
        int j = i - 1;
        
        while (j >= 0 && array[j] > key) {
            array[j + 1] = array[j];
            j--;
        }
        array[j + 1] = key;
    }
}

/* Helper function to read raw value as float */
static float read_raw_float(struct hx711_advanced_data *hx711)
{
    int32_t raw_value;
    int ret = hx711_read_raw(&hx711->base, &raw_value);
    if (ret < 0) {
        return 0.0f;
    }
    return (float)raw_value;
}

int hx711_advanced_init(struct hx711_advanced_data *hx711,
                       const struct device *dout_dev, gpio_pin_t dout_pin, gpio_flags_t dout_flags,
                       const struct device *sck_dev, gpio_pin_t sck_pin, gpio_flags_t sck_flags)
{
    if (!hx711) {
        return -EINVAL;
    }
    
    /* Initialize base HX711 */
    int ret = hx711_init(&hx711->base, dout_dev, dout_pin, dout_flags, sck_dev, sck_pin, sck_flags);
    if (ret < 0) {
        return ret;
    }
    
    /* Initialize advanced parameters */
    hx711->offset = 0;
    hx711->scale = 1.0f;
    hx711->tare_offset = 0.0f;
    hx711->tare_set_flag = false;
    hx711->mode = HX711_AVERAGE_MODE;
    hx711->gain = HX711_CHANNEL_A_GAIN_128;
    hx711->runavg_value = 0.0f;
    hx711->runavg_initialized = false;
    hx711->last_read_time = 0;
    hx711->unit_price = 1.0f;
    
    return 0;
}

float hx711_read_average(struct hx711_advanced_data *hx711, uint8_t times)
{
    if (times < 1) times = 1;
    
    float sum = 0.0f;
    for (uint8_t i = 0; i < times; i++) {
        sum += read_raw_float(hx711);
        k_msleep(1); /* Small delay between readings */
    }
    
    hx711->last_read_time = k_uptime_get();
    return sum / times;
}

float hx711_read_median(struct hx711_advanced_data *hx711, uint8_t times)
{
    if (times > 15) times = 15;
    if (times < 3) times = 3;
    
    float samples[15];
    for (uint8_t i = 0; i < times; i++) {
        samples[i] = read_raw_float(hx711);
        k_msleep(1);
    }
    
    insert_sort(samples, times);
    
    if (times & 0x01) {
        /* Odd number of samples */
        hx711->last_read_time = k_uptime_get();
        return samples[times/2];
    } else {
        /* Even number of samples - average of two middle values */
        hx711->last_read_time = k_uptime_get();
        return (samples[times/2 - 1] + samples[times/2]) / 2.0f;
    }
}

float hx711_read_medavg(struct hx711_advanced_data *hx711, uint8_t times)
{
    if (times > 15) times = 15;
    if (times < 3) times = 3;
    
    float samples[15];
    for (uint8_t i = 0; i < times; i++) {
        samples[i] = read_raw_float(hx711);
        k_msleep(1);
    }
    
    insert_sort(samples, times);
    
    /* Calculate average of middle half */
    uint8_t start = times / 4;
    uint8_t end = times - start;
    float sum = 0.0f;
    
    for (uint8_t i = start; i < end; i++) {
        sum += samples[i];
    }
    
    hx711->last_read_time = k_uptime_get();
    return sum / (end - start);
}

float hx711_read_runavg(struct hx711_advanced_data *hx711, uint8_t times, float alpha)
{
    if (times < 1) times = 1;
    if (alpha < 0.0f) alpha = 0.0f;
    if (alpha > 1.0f) alpha = 1.0f;
    
    float current_value = read_raw_float(hx711);
    
    if (!hx711->runavg_initialized) {
        hx711->runavg_value = current_value;
        hx711->runavg_initialized = true;
    } else {
        hx711->runavg_value = alpha * current_value + (1.0f - alpha) * hx711->runavg_value;
    }
    
    hx711->last_read_time = k_uptime_get();
    return hx711->runavg_value;
}

void hx711_set_raw_mode(struct hx711_advanced_data *hx711)
{
    hx711->mode = HX711_RAW_MODE;
}

void hx711_set_average_mode(struct hx711_advanced_data *hx711)
{
    hx711->mode = HX711_AVERAGE_MODE;
}

void hx711_set_median_mode(struct hx711_advanced_data *hx711)
{
    hx711->mode = HX711_MEDIAN_MODE;
}

void hx711_set_medavg_mode(struct hx711_advanced_data *hx711)
{
    hx711->mode = HX711_MEDAVG_MODE;
}

void hx711_set_runavg_mode(struct hx711_advanced_data *hx711)
{
    hx711->mode = HX711_RUNAVG_MODE;
}

uint8_t hx711_get_mode(struct hx711_advanced_data *hx711)
{
    return hx711->mode;
}

float hx711_get_value(struct hx711_advanced_data *hx711, uint8_t times)
{
    float raw_value;
    
    switch (hx711->mode) {
        case HX711_RAW_MODE:
            raw_value = read_raw_float(hx711);
            break;
        case HX711_AVERAGE_MODE:
            raw_value = hx711_read_average(hx711, times);
            break;
        case HX711_MEDIAN_MODE:
            raw_value = hx711_read_median(hx711, times);
            break;
        case HX711_MEDAVG_MODE:
            raw_value = hx711_read_medavg(hx711, times);
            break;
        case HX711_RUNAVG_MODE:
            raw_value = hx711_read_runavg(hx711, times, 0.5f);
            break;
        default:
            raw_value = hx711_read_average(hx711, times);
            break;
    }
    
    return raw_value - hx711->offset;
}

float hx711_get_units(struct hx711_advanced_data *hx711, uint8_t times)
{
    float value = hx711_get_value(hx711, times);
    return value / hx711->scale;
}

bool hx711_set_gain(struct hx711_advanced_data *hx711, uint8_t gain, bool forced)
{
    if (!forced && hx711->gain == gain) {
        return true; /* Already set to this gain */
    }
    
    /* Validate gain value */
    if (gain != HX711_CHANNEL_A_GAIN_128 && 
        gain != HX711_CHANNEL_A_GAIN_64 && 
        gain != HX711_CHANNEL_B_GAIN_32) {
        return false;
    }
    
    hx711->gain = gain;
    
    /* Note: In a real implementation, you would need to read from the sensor
     * to apply the new gain setting, as the gain is set by the number of
     * clock pulses after the 24 data bits */
    
    return true;
}

uint8_t hx711_get_gain(struct hx711_advanced_data *hx711)
{
    return hx711->gain;
}

void hx711_tare(struct hx711_advanced_data *hx711, uint8_t times)
{
    float tare_value = hx711_read_average(hx711, times);
    hx711->tare_offset = tare_value;
    hx711->tare_set_flag = true;
    printk("HX711: Tare set to %.2f\n", (double)tare_value);
}

float hx711_get_tare(struct hx711_advanced_data *hx711)
{
    return hx711->tare_offset;
}

bool hx711_tare_set(struct hx711_advanced_data *hx711)
{
    return hx711->tare_set_flag;
}

bool hx711_set_scale(struct hx711_advanced_data *hx711, float scale)
{
    if (scale <= 0.0f) {
        return false;
    }
    
    hx711->scale = scale;
    return true;
}

float hx711_get_scale(struct hx711_advanced_data *hx711)
{
    return hx711->scale;
}

void hx711_set_offset(struct hx711_advanced_data *hx711, int32_t offset)
{
    hx711->offset = offset;
}

int32_t hx711_get_offset(struct hx711_advanced_data *hx711)
{
    return hx711->offset;
}

void hx711_calibrate_scale(struct hx711_advanced_data *hx711, float weight, uint8_t times)
{
    if (weight <= 0.0f) {
        printk("HX711: Invalid weight for calibration\n");
        return;
    }
    
    /* First, tare the scale if not already done */
    if (!hx711->tare_set_flag) {
        hx711_tare(hx711, times);
    }
    
    /* Read the raw value with the known weight */
    float raw_value = hx711_read_average(hx711, times);
    
    /* Calculate scale factor */
    float new_scale = (raw_value - hx711->tare_offset) / weight;
    
    if (new_scale > 0.0f) {
        hx711->scale = new_scale;
        printk("HX711: Scale calibrated to %.6f\n", (double)new_scale);
    } else {
        printk("HX711: Calibration failed - invalid scale factor\n");
    }
}

uint32_t hx711_last_time_read(struct hx711_advanced_data *hx711)
{
    return hx711->last_read_time;
}

void hx711_reset_advanced(struct hx711_advanced_data *hx711)
{
    hx711->offset = 0;
    hx711->scale = 1.0f;
    hx711->tare_offset = 0.0f;
    hx711->tare_set_flag = false;
    hx711->mode = HX711_AVERAGE_MODE;
    hx711->gain = HX711_CHANNEL_A_GAIN_128;
    hx711->runavg_value = 0.0f;
    hx711->runavg_initialized = false;
    hx711->last_read_time = 0;
    hx711->unit_price = 1.0f;
    
    printk("HX711: Advanced settings reset\n");
}

float hx711_get_price(struct hx711_advanced_data *hx711, uint8_t times)
{
    return hx711_get_units(hx711, times) * hx711->unit_price;
}

void hx711_set_unit_price(struct hx711_advanced_data *hx711, float price)
{
    hx711->unit_price = price;
}

float hx711_get_unit_price(struct hx711_advanced_data *hx711)
{
    return hx711->unit_price;
} 
```

## src/hx711_advanced.h
```c
/*
 * Copyright (c) 2025 HX711 Advanced Functions for Zephyr by GP
 * SPDX-License-Identifier: Apache-2.0
 */

#ifndef HX711_ADVANCED_H_
#define HX711_ADVANCED_H_

#include "hx711_driver.h"
#include <zephyr/kernel.h>
#include <stdint.h>
#include <stdbool.h>

#ifdef __cplusplus
extern "C" {
#endif

/* Reading modes */
#define HX711_AVERAGE_MODE    0x00
#define HX711_MEDIAN_MODE     0x01
#define HX711_MEDAVG_MODE     0x02
#define HX711_RUNAVG_MODE     0x03
#define HX711_RAW_MODE        0x04

/* Gain constants */
#define HX711_CHANNEL_A_GAIN_128  128
#define HX711_CHANNEL_A_GAIN_64   64
#define HX711_CHANNEL_B_GAIN_32   32

/* Advanced HX711 data structure */
struct hx711_advanced_data {
    struct hx711_data base;           /* Base HX711 data */
    
    /* Calibration data */
    int32_t offset;
    float scale;
    float tare_offset;
    bool tare_set_flag;
    
    /* Reading mode */
    uint8_t mode;
    
    /* Gain setting */
    uint8_t gain;
    
    /* Running average data */
    float runavg_value;
    bool runavg_initialized;
    
    /* Timing */
    uint32_t last_read_time;
    
    /* Pricing (optional) */
    float unit_price;
};

/* Advanced initialization */
int hx711_advanced_init(struct hx711_advanced_data *hx711,
                       const struct device *dout_dev, gpio_pin_t dout_pin, gpio_flags_t dout_flags,
                       const struct device *sck_dev, gpio_pin_t sck_pin, gpio_flags_t sck_flags);

/* Advanced reading functions */
float hx711_read_average(struct hx711_advanced_data *hx711, uint8_t times);
float hx711_read_median(struct hx711_advanced_data *hx711, uint8_t times);
float hx711_read_medavg(struct hx711_advanced_data *hx711, uint8_t times);
float hx711_read_runavg(struct hx711_advanced_data *hx711, uint8_t times, float alpha);

/* Mode setting functions */
void hx711_set_raw_mode(struct hx711_advanced_data *hx711);
void hx711_set_average_mode(struct hx711_advanced_data *hx711);
void hx711_set_median_mode(struct hx711_advanced_data *hx711);
void hx711_set_medavg_mode(struct hx711_advanced_data *hx711);
void hx711_set_runavg_mode(struct hx711_advanced_data *hx711);
uint8_t hx711_get_mode(struct hx711_advanced_data *hx711);

/* Processed reading functions */
float hx711_get_value(struct hx711_advanced_data *hx711, uint8_t times);
float hx711_get_units(struct hx711_advanced_data *hx711, uint8_t times);

/* Gain functions */
bool hx711_set_gain(struct hx711_advanced_data *hx711, uint8_t gain, bool forced);
uint8_t hx711_get_gain(struct hx711_advanced_data *hx711);

/* Tare functions */
void hx711_tare(struct hx711_advanced_data *hx711, uint8_t times);
float hx711_get_tare(struct hx711_advanced_data *hx711);
bool hx711_tare_set(struct hx711_advanced_data *hx711);

/* Calibration functions */
bool hx711_set_scale(struct hx711_advanced_data *hx711, float scale);
float hx711_get_scale(struct hx711_advanced_data *hx711);
void hx711_set_offset(struct hx711_advanced_data *hx711, int32_t offset);
int32_t hx711_get_offset(struct hx711_advanced_data *hx711);
void hx711_calibrate_scale(struct hx711_advanced_data *hx711, float weight, uint8_t times);

/* Utility functions */
uint32_t hx711_last_time_read(struct hx711_advanced_data *hx711);
void hx711_reset_advanced(struct hx711_advanced_data *hx711);

/* Pricing functions */
float hx711_get_price(struct hx711_advanced_data *hx711, uint8_t times);
void hx711_set_unit_price(struct hx711_advanced_data *hx711, float price);
float hx711_get_unit_price(struct hx711_advanced_data *hx711);

#ifdef __cplusplus
}
#endif

#endif /* HX711_ADVANCED_H_ */ 
```

## src/hx711_config.h
```c
/*
 * Copyright (c) 2025 HX711 Pin Configuration created by GP
 * SPDX-License-Identifier: Apache-2.0
 */

#ifndef HX711_CONFIG_H
#define HX711_CONFIG_H

#include <zephyr/kernel.h>
#include <zephyr/device.h>
#include <zephyr/drivers/gpio.h>
#include <zephyr/devicetree.h>

/* HX711 Pin Configuration - Easy to change for different hardware setups */

/* Get GPIO devices from device tree */
#define GPIO0_DEVICE DEVICE_DT_GET(DT_NODELABEL(gpio0))
#define GPIO1_DEVICE DEVICE_DT_GET(DT_NODELABEL(gpio1))

/* HX711 Sensor 0 - TENS_1 */
#define HX711_0_SCK_DEV GPIO1_DEVICE
#define HX711_0_SCK_PIN 11
#define HX711_0_SCK_FLAGS (GPIO_OUTPUT | GPIO_OUTPUT_LOW)

#define HX711_0_DOUT_DEV GPIO0_DEVICE
#define HX711_0_DOUT_PIN 29
#define HX711_0_DOUT_FLAGS (GPIO_INPUT | GPIO_PULL_UP)

#define HX711_0_RATE_DEV NULL
#define HX711_0_RATE_PIN 0
#define HX711_0_RATE_FLAGS 0

/* HX711 Sensor 1 - TENS_2 */
#define HX711_1_SCK_DEV GPIO1_DEVICE
#define HX711_1_SCK_PIN 15
#define HX711_1_SCK_FLAGS (GPIO_OUTPUT | GPIO_OUTPUT_LOW)

#define HX711_1_DOUT_DEV GPIO0_DEVICE
#define HX711_1_DOUT_PIN 3
#define HX711_1_DOUT_FLAGS (GPIO_INPUT | GPIO_PULL_UP)

#define HX711_1_RATE_DEV NULL
#define HX711_1_RATE_PIN 0
#define HX711_1_RATE_FLAGS 0

/* HX711 Sensor 2 - TENS_3 */
#define HX711_2_SCK_DEV GPIO1_DEVICE
#define HX711_2_SCK_PIN 14
#define HX711_2_SCK_FLAGS (GPIO_OUTPUT | GPIO_OUTPUT_LOW)

#define HX711_2_DOUT_DEV GPIO0_DEVICE
#define HX711_2_DOUT_PIN 28
#define HX711_2_DOUT_FLAGS (GPIO_INPUT | GPIO_PULL_UP)

#define HX711_2_RATE_DEV NULL
#define HX711_2_RATE_PIN 0
#define HX711_2_RATE_FLAGS 0

/* HX711 Configuration - Updated based on datasheet */
/* Note: Rate and gain are linked according to datasheet Table 1:
 * - 25 pulses: Channel A, Gain 128, 10 SPS
 * - 26 pulses: Channel B, Gain 32, 10 SPS  
 * - 27 pulses: Channel A, Gain 64, 80 SPS
 */
#define HX711_DEFAULT_GAIN 64      /* Default gain (will be set to 64 for 80 SPS) */
#define HX711_DEFAULT_RATE_SPS 80  /* Default data rate in SPS */
#define HX711_SLEEP_DELAY_US 70    /* >60µs for sleep mode */

/* Calibration values (to be determined experimentally) */
#define HX711_0_OFFSET 0
#define HX711_0_SCALE 1.0f

#define HX711_1_OFFSET 0
#define HX711_1_SCALE 1.0f

#define HX711_2_OFFSET 0
#define HX711_2_SCALE 1.0f

#endif /* HX711_CONFIG_H */ 
```

## src/hx711_demo.c
```c
/*
 * Copyright (c) 2025 HX711 Advanced Demo Application by GP
 * SPDX-License-Identifier: Apache-2.0
 */

#include <zephyr/kernel.h>
#include <zephyr/sys/printk.h>
#include "hx711_advanced.h"
#include "hx711_config.h"
#include <math.h>

/* Advanced HX711 sensor instances */
static struct hx711_advanced_data hx711_adv_0;
static struct hx711_advanced_data hx711_adv_1;
static struct hx711_advanced_data hx711_adv_2;

/* Demo state */
static bool demo_initialized = false;

/* Function prototypes */
void demo_initialize_sensors(void);
void demo_basic_reading(void);
void demo_reading_modes(void);
void demo_calibration_process(void);
void demo_tare_functionality(void);
void demo_advanced_features(void);
void demo_continuous_monitoring(void);
void print_sensor_status(struct hx711_advanced_data *hx711, const char *name);

void demo_initialize_sensors(void)
{
    printk("\n=== HX711 ADVANCED DEMO INITIALIZATION ===\n");
    
    /* Initialize advanced HX711 sensors */
    int ret = hx711_advanced_init(&hx711_adv_0,
                                 HX711_0_DOUT_DEV, HX711_0_DOUT_PIN, HX711_0_DOUT_FLAGS,
                                 HX711_0_SCK_DEV, HX711_0_SCK_PIN, HX711_0_SCK_FLAGS);
    if (ret < 0) {
        printk("Failed to initialize advanced HX711 sensor 0: %d\n", ret);
        return;
    }
    
    ret = hx711_advanced_init(&hx711_adv_1,
                             HX711_1_DOUT_DEV, HX711_1_DOUT_PIN, HX711_1_DOUT_FLAGS,
                             HX711_1_SCK_DEV, HX711_1_SCK_PIN, HX711_1_SCK_FLAGS);
    if (ret < 0) {
        printk("Failed to initialize advanced HX711 sensor 1: %d\n", ret);
        return;
    }
    
    ret = hx711_advanced_init(&hx711_adv_2,
                             HX711_2_DOUT_DEV, HX711_2_DOUT_PIN, HX711_2_DOUT_FLAGS,
                             HX711_2_SCK_DEV, HX711_2_SCK_PIN, HX711_2_SCK_FLAGS);
    if (ret < 0) {
        printk("Failed to initialize advanced HX711 sensor 2: %d\n", ret);
        return;
    }
    
    printk("All advanced HX711 sensors initialized successfully!\n");
    demo_initialized = true;
}

void demo_basic_reading(void)
{
    if (!demo_initialized) return;
    
    printk("\n=== BASIC READING DEMO ===\n");
    
    /* Test raw reading */
    printk("Testing raw readings...\n");
    float raw_0 = hx711_read_average(&hx711_adv_0, 5);
    float raw_1 = hx711_read_average(&hx711_adv_1, 5);
    float raw_2 = hx711_read_average(&hx711_adv_2, 5);
    
    printk("Raw values (5 samples avg): Sensor0=%.2f, Sensor1=%.2f, Sensor2=%.2f\n", 
           (double)raw_0, (double)raw_1, (double)raw_2);
    
    /* Test different reading modes */
    printk("\nTesting different reading modes on Sensor 0:\n");
    
    /* Raw mode */
    hx711_set_raw_mode(&hx711_adv_0);
    float raw_mode = hx711_get_value(&hx711_adv_0, 1);
    printk("  Raw mode: %.2f\n", (double)raw_mode);
    
    /* Average mode */
    hx711_set_average_mode(&hx711_adv_0);
    float avg_mode = hx711_get_value(&hx711_adv_0, 10);
    printk("  Average mode (10 samples): %.2f\n", (double)avg_mode);
    
    /* Median mode */
    hx711_set_median_mode(&hx711_adv_0);
    float med_mode = hx711_get_value(&hx711_adv_0, 7);
    printk("  Median mode (7 samples): %.2f\n", (double)med_mode);
    
    /* Running average mode */
    hx711_set_runavg_mode(&hx711_adv_0);
    float runavg_mode = hx711_get_value(&hx711_adv_0, 1);
    printk("  Running average mode: %.2f\n", (double)runavg_mode);
    
    /* Reset to average mode */
    hx711_set_average_mode(&hx711_adv_0);
}

void demo_reading_modes(void)
{
    if (!demo_initialized) return;
    
    printk("\n=== READING MODES COMPARISON ===\n");
    
    printk("Comparing different reading modes on Sensor 1:\n");
    printk("Format: Mode | Raw Value | Offset Corrected | Units\n");
    
    /* Test all modes */
    const char *modes[] = {"Raw", "Average", "Median", "MedAvg", "RunAvg"};
    uint8_t mode_values[] = {HX711_RAW_MODE, HX711_AVERAGE_MODE, HX711_MEDIAN_MODE, 
                            HX711_MEDAVG_MODE, HX711_RUNAVG_MODE};
    
    for (int i = 0; i < 5; i++) {
        switch(mode_values[i]) {
            case HX711_RAW_MODE:
                hx711_set_raw_mode(&hx711_adv_1);
                break;
            case HX711_AVERAGE_MODE:
                hx711_set_average_mode(&hx711_adv_1);
                break;
            case HX711_MEDIAN_MODE:
                hx711_set_median_mode(&hx711_adv_1);
                break;
            case HX711_MEDAVG_MODE:
                hx711_set_medavg_mode(&hx711_adv_1);
                break;
            case HX711_RUNAVG_MODE:
                hx711_set_runavg_mode(&hx711_adv_1);
                break;
        }
        float raw_val = hx711_get_value(&hx711_adv_1, 5);
        float units = hx711_get_units(&hx711_adv_1, 5);
        
        printk("%-8s | %8.2f | %15.2f | %8.2f\n", 
               modes[i], (double)(raw_val + hx711_adv_1.offset), (double)raw_val, (double)units);
    }
    
    /* Reset to average mode */
    hx711_set_average_mode(&hx711_adv_1);
}

void demo_calibration_process(void)
{
    if (!demo_initialized) return;
    
    printk("\n=== CALIBRATION PROCESS DEMO ===\n");
    
    printk("Demonstrating calibration process on Sensor 2:\n");
    
    /* Step 1: Tare the scale */
    printk("Step 1: Taring the scale (remove all weight)\n");
    hx711_tare(&hx711_adv_2, 10);
    printk("  Tare offset set to: %.2f\n", (double)hx711_get_tare(&hx711_adv_2));
    
    /* Step 2: Set a known scale factor (simulated calibration) */
    printk("Step 2: Setting scale factor (simulated calibration with 1000g weight)\n");
    float simulated_weight = 1000.0f;  /* 1000 grams */
    float simulated_raw_value = 50000.0f;  /* Simulated raw reading */
    
    /* Calculate scale factor */
    float scale_factor = (simulated_raw_value - hx711_adv_2.tare_offset) / simulated_weight;
    hx711_set_scale(&hx711_adv_2, scale_factor);
    
    printk("  Scale factor set to: %.6f\n", (double)hx711_get_scale(&hx711_adv_2));
    printk("  This means 1 unit = %.4f grams\n", (double)(1.0f / hx711_get_scale(&hx711_adv_2)));
    
    /* Step 3: Test the calibration */
    printk("Step 3: Testing calibration\n");
    float test_units = hx711_get_units(&hx711_adv_2, 5);
    printk("  Current reading in units: %.2f\n", (double)test_units);
    
    /* Simulate different weights */
    printk("Step 4: Simulating different weights\n");
    for (int weight = 0; weight <= 2000; weight += 500) {
        /* Simulate weight by adjusting offset */
        float simulated_offset = hx711_adv_2.tare_offset + (weight * scale_factor);
        hx711_set_offset(&hx711_adv_2, (int32_t)simulated_offset);
        
        float units = hx711_get_units(&hx711_adv_2, 1);
        printk("  Simulated %d grams -> Reading: %.1f grams\n", weight, (double)units);
    }
    
    /* Reset offset */
    hx711_set_offset(&hx711_adv_2, 0);
}

void demo_tare_functionality(void)
{
    if (!demo_initialized) return;
    
    printk("\n=== TARE FUNCTIONALITY DEMO ===\n");
    
    printk("Demonstrating tare functionality on Sensor 0:\n");
    
    /* Initial state */
    printk("Initial state:\n");
    print_sensor_status(&hx711_adv_0, "Sensor 0");
    
    /* First tare */
    printk("\nStep 1: First tare (empty scale)\n");
    hx711_tare(&hx711_adv_0, 5);
    print_sensor_status(&hx711_adv_0, "Sensor 0");
    
    /* Simulate adding weight */
    printk("\nStep 2: Simulating adding 500g weight\n");
    float weight_offset = 500.0f * hx711_adv_0.scale;
    hx711_set_offset(&hx711_adv_0, (int32_t)weight_offset);
    
    float units = hx711_get_units(&hx711_adv_0, 1);
    printk("  Reading with 500g weight: %.1f grams\n", (double)units);
    
    /* Second tare (with weight on scale) */
    printk("\nStep 3: Second tare (with weight on scale)\n");
    hx711_tare(&hx711_adv_0, 5);
    print_sensor_status(&hx711_adv_0, "Sensor 0");
    
    /* Simulate adding more weight */
    printk("\nStep 4: Simulating adding 200g more weight\n");
    float additional_offset = 200.0f * hx711_adv_0.scale;
    hx711_set_offset(&hx711_adv_0, (int32_t)additional_offset);
    
    units = hx711_get_units(&hx711_adv_0, 1);
    printk("  Reading with additional 200g: %.1f grams\n", (double)units);
    
    /* Reset */
    hx711_set_offset(&hx711_adv_0, 0);
    hx711_reset_advanced(&hx711_adv_0);
}

void demo_advanced_features(void)
{
    if (!demo_initialized) return;
    
    printk("\n=== ADVANCED FEATURES DEMO ===\n");
    
    printk("Testing advanced features on Sensor 1:\n");
    
    /* Gain setting */
    printk("Gain settings:\n");
    printk("  Current gain: %d\n", hx711_get_gain(&hx711_adv_1));
    
    bool ret = hx711_set_gain(&hx711_adv_1, HX711_CHANNEL_A_GAIN_64, false);
    printk("  Setting gain to 64: %s\n", ret ? "Success" : "Failed");
    printk("  New gain: %d\n", hx711_get_gain(&hx711_adv_1));
    
    /* Pricing functionality */
    printk("\nPricing functionality:\n");
    hx711_set_unit_price(&hx711_adv_1, 2.50f);  /* $2.50 per gram */
    printk("  Unit price set to: $%.2f per gram\n", (double)hx711_get_unit_price(&hx711_adv_1));
    
    /* Simulate weight and calculate price */
    float test_weight = 100.0f;  /* 100 grams */
    hx711_set_offset(&hx711_adv_1, (int32_t)(test_weight * hx711_adv_1.scale));
    
    float units = hx711_get_units(&hx711_adv_1, 1);
    float price = hx711_get_price(&hx711_adv_1, 1);
    printk("  Weight: %.1f grams, Price: $%.2f\n", (double)units, (double)price);
    
    /* Timing information */
    printk("\nTiming information:\n");
    uint32_t last_read = hx711_last_time_read(&hx711_adv_1);
    printk("  Last read time: %u ms\n", last_read);
    
    /* Reset */
    hx711_set_offset(&hx711_adv_1, 0);
    hx711_set_gain(&hx711_adv_1, HX711_CHANNEL_A_GAIN_128, true);
}

void demo_continuous_monitoring(void)
{
    if (!demo_initialized) return;
    
    printk("\n=== CONTINUOUS MONITORING DEMO ===\n");
    printk("Starting continuous monitoring for 10 seconds...\n");
    printk("Format: Time(ms) | Sensor0(g) | Sensor1(g) | Sensor2(g)\n");
    
    uint32_t start_time = k_uptime_get();
    uint32_t last_print = 0;
    
    while (k_uptime_get() - start_time < 10000) {  /* 10 seconds */
        uint32_t current_time = k_uptime_get();
        
        /* Print every 500ms */
        if (current_time - last_print >= 500) {
            float units_0 = hx711_get_units(&hx711_adv_0, 3);
            float units_1 = hx711_get_units(&hx711_adv_1, 3);
            float units_2 = hx711_get_units(&hx711_adv_2, 3);
            
            printk("%8u | %9.1f | %9.1f | %9.1f\n", 
                   current_time - start_time, (double)units_0, (double)units_1, (double)units_2);
            
            last_print = current_time;
        }
        
        k_msleep(100);
    }
    
    printk("Continuous monitoring completed.\n");
}

void print_sensor_status(struct hx711_advanced_data *hx711, const char *name)
{
    printk("%s Status:\n", name);
    printk("  Offset: %d\n", hx711_get_offset(hx711));
    printk("  Scale: %.6f\n", (double)hx711_get_scale(hx711));
    printk("  Tare offset: %.2f\n", (double)hx711_get_tare(hx711));
    printk("  Tare set: %s\n", hx711_tare_set(hx711) ? "Yes" : "No");
    printk("  Mode: %d\n", hx711_get_mode(hx711));
    printk("  Gain: %d\n", hx711_get_gain(hx711));
    printk("  Current units: %.2f\n", (double)hx711_get_units(hx711, 1));
}

void run_hx711_advanced_demo(void)
{
    printk("\n============================================================\n");
    printk("HX711 ADVANCED FUNCTIONS DEMONSTRATION\n");
    printk("============================================================\n");
    
    /* Initialize sensors */
    demo_initialize_sensors();
    if (!demo_initialized) {
        printk("Failed to initialize sensors. Demo cannot continue.\n");
        return;
    }
    
    /* Run all demos */
    demo_basic_reading();
    k_msleep(2000);
    
    demo_reading_modes();
    k_msleep(2000);
    
    demo_calibration_process();
    k_msleep(2000);
    
    demo_tare_functionality();
    k_msleep(2000);
    
    demo_advanced_features();
    k_msleep(2000);
    
    demo_continuous_monitoring();
    
    printk("\n============================================================\n");
    printk("HX711 ADVANCED DEMO COMPLETED\n");
    printk("============================================================\n");
} 
```

## src/hx711_demo.h
```c
/*
 * Copyright (c) 2025 HX711 Demo Header by GP
 * SPDX-License-Identifier: Apache-2.0
 */

#ifndef HX711_DEMO_H_
#define HX711_DEMO_H_

#ifdef __cplusplus
extern "C" {
#endif

/* Demo function prototype */
void run_hx711_advanced_demo(void);

#ifdef __cplusplus
}
#endif

#endif /* HX711_DEMO_H_ */ 
```

## src/hx711_driver.c
```c
/*
 * Copyright (c) 2025 HX711 Driver for Zephyr by GP
 * SPDX-License-Identifier: Apache-2.0
 */

#include "hx711_driver.h"
#include <zephyr/kernel.h>
#include <zephyr/drivers/gpio.h>
#include <zephyr/sys/util.h>
#include  <stdint.h>
#include <zephyr/sys/printk.h>

int hx711_init(struct hx711_data *hx711, 
               const struct device *dout_dev, gpio_pin_t dout_pin, gpio_flags_t dout_flags,
               const struct device *sck_dev, gpio_pin_t sck_pin, gpio_flags_t sck_flags)
{
	int ret;

	if (!hx711 || !dout_dev || !sck_dev) {
		return -EINVAL;
	}

	/* Store device handles */
	hx711->dout_dev = dout_dev;
	hx711->sck_dev = sck_dev;

	/* Store pin information */
	hx711->dout_pin = dout_pin;
	hx711->sck_pin = sck_pin;
	hx711->dout_flags = dout_flags;
	hx711->sck_flags = sck_flags;

	/* Configure DOUT pin as input with pull-up */
	ret = gpio_pin_configure(hx711->dout_dev, dout_pin, dout_flags);
	if (ret < 0) {
		printk("Failed to configure DOUT pin: %d\n", ret);
		return ret;
	}

	/* Configure SCK pin as output, initially low */
	ret = gpio_pin_configure(hx711->sck_dev, sck_pin, sck_flags);
	if (ret < 0) {
		printk("Failed to configure SCK pin: %d\n", ret);
		return ret;
	}

	/* Power up delay - HX711 needs time to stabilize */
	k_msleep(400);

	/* Set default rate */
	hx711->rate_sps = HX711_DEFAULT_RATE_SPS;

	hx711->is_initialized = true;

	return 0;
}

int hx711_read_raw(struct hx711_data *hx711, int32_t *value)
{
	int ret;
	int32_t raw_value = 0;
	uint8_t i;

	if (!hx711 || !value || !hx711->is_initialized) {
		return -EINVAL;
	}

	/* Wait for data to be ready - use shorter timeout */
	ret = hx711_wait_for_data(hx711, K_MSEC(50));
	if (ret < 0) {
		return ret;
	}

	/* Read 24 bits of data */
	for (i = 0; i < 24; i++) {
		/* Clock high */
		ret = gpio_pin_set(hx711->sck_dev, hx711->sck_pin, 1);
		if (ret < 0) {
			return ret;
		}
		k_busy_wait(1);

		/* Read data bit */
		int data_bit = gpio_pin_get(hx711->dout_dev, hx711->dout_pin);
		if (data_bit < 0) {
			return data_bit;
		}

		/* Clock low */
		ret = gpio_pin_set(hx711->sck_dev, hx711->sck_pin, 0);
		if (ret < 0) {
			return ret;
		}
		k_busy_wait(1);

		/* Shift data into result */
		raw_value = (raw_value << 1) | data_bit;
	}

	/* Additional clock pulses to set channel and gain for next reading */
	/* For 80 SPS: 27 total pulses (24 data + 3 config) = Channel A, Gain 64 */
	/* For 10 SPS: 25 total pulses (24 data + 1 config) = Channel A, Gain 128 */
	/* For 10 SPS: 26 total pulses (24 data + 2 config) = Channel B, Gain 32 */
	
	/* We want 80 SPS, so we need 3 additional pulses (27 total) */
	for (i = 0; i < 3; i++) {
		ret = gpio_pin_set(hx711->sck_dev, hx711->sck_pin, 1);
		if (ret < 0) {
			return ret;
		}
		k_busy_wait(1);

		ret = gpio_pin_set(hx711->sck_dev, hx711->sck_pin, 0);
		if (ret < 0) {
			return ret;
		}
		k_busy_wait(1);
	}

	/* Convert to signed 24-bit value */
	if (raw_value & 0x800000) {
		raw_value |= 0xFF000000;  /* Sign extend negative values */
	}

	*value = raw_value;
	return 0;
}

int hx711_set_rate(struct hx711_data *hx711, uint8_t rate_sps)
{
	/* Store the desired rate for next reading */
	hx711->rate_sps = rate_sps;
	printk("HX711: Rate set to %d SPS (will be applied on next reading)\n", rate_sps);
	return 0;
}

int hx711_wait_for_data(struct hx711_data *hx711, k_timeout_t timeout)
{
	int ret;
	int64_t start_time = k_uptime_get();

	if (!hx711 || !hx711->is_initialized) {
		return -EINVAL;
	}

	/* Wait for DOUT to go low (data ready) */
	while (k_uptime_get() - start_time < timeout.ticks) {
		ret = gpio_pin_get(hx711->dout_dev, hx711->dout_pin);
		if (ret < 0) {
			return ret;
		}
		if (ret == 0) {
			return 0;  /* Data is ready */
		}
		k_msleep(1);
	}

	return -ETIMEDOUT;
}

int hx711_sleep(struct hx711_data *hx711)
{
	int ret;

	if (!hx711 || !hx711->is_initialized) {
		return -EINVAL;
	}

	/* Set SCK high to enter sleep mode */
	ret = gpio_pin_set(hx711->sck_dev, hx711->sck_pin, 1);
	if (ret < 0) {
		return ret;
	}

	/* Wait for sleep mode to take effect (>60us required) */
	k_busy_wait(HX711_SLEEP_DELAY_US);

	printk("HX711 entered sleep mode\n");
	return 0;
}

int hx711_wake_up(struct hx711_data *hx711)
{
	int ret;

	if (!hx711 || !hx711->is_initialized) {
		return -EINVAL;
	}

	/* Set SCK low to wake up */
	ret = gpio_pin_set(hx711->sck_dev, hx711->sck_pin, 0);
	if (ret < 0) {
		return ret;
	}

	/* Wait for power up settling time */
	k_sleep(K_MSEC(400));

	printk("HX711 woke up from sleep mode\n");
	return 0;
}

bool hx711_is_data_ready(struct hx711_data *hx711)
{
	int ret;

	if (!hx711 || !hx711->is_initialized) {
		return false;
	}

	ret = gpio_pin_get(hx711->dout_dev, hx711->dout_pin);
	return (ret == 0);  /* Data ready when DOUT is low */
} 
```

## src/hx711_driver.h
```c
/*
 * Copyright (c) 2025 HX711 Driver for Zephyr by GP
 * SPDX-License-Identifier: Apache-2.0
 */

#ifndef HX711_DRIVER_H_
#define HX711_DRIVER_H_

#include <zephyr/kernel.h>
#include <zephyr/drivers/gpio.h>
#include <zephyr/device.h>
#include "hx711_config.h"

#ifdef __cplusplus
extern "C" {
#endif

/* HX711 data structure */
struct hx711_data {
	const struct device *dout_dev;
	const struct device *sck_dev;
	gpio_pin_t dout_pin;
	gpio_pin_t sck_pin;
	gpio_flags_t dout_flags;
	gpio_flags_t sck_flags;
	bool is_initialized;
	uint8_t rate_sps;  /* Desired sampling rate in SPS */
};

/* Function prototypes */
int hx711_init(struct hx711_data *hx711, 
               const struct device *dout_dev, gpio_pin_t dout_pin, gpio_flags_t dout_flags,
               const struct device *sck_dev, gpio_pin_t sck_pin, gpio_flags_t sck_flags);

int hx711_read_raw(struct hx711_data *hx711, int32_t *value);
int hx711_wait_for_data(struct hx711_data *hx711, k_timeout_t timeout);
int hx711_sleep(struct hx711_data *hx711);
int hx711_wake_up(struct hx711_data *hx711);
int hx711_set_rate(struct hx711_data *hx711, uint8_t rate_sps);
bool hx711_is_data_ready(struct hx711_data *hx711);

#ifdef __cplusplus
}
#endif

#endif /* HX711_DRIVER_H_ */ 
```
